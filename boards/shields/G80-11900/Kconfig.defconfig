## boards/shields/G80-11900/Kconfig.defconfig
```kconfig
if SHIELD_G80_11900

# Name must be less than 16 characters long!
config ZMK_KEYBOARD_NAME
    default "CherryG80-11900"
config SPI
    default y

endif
```

## boards/shields/G80-11900/Kconfig.shield
```kconfig
# No whitespace after the comma or in your keyboard name!
config SHIELD_G80_11900
    def_bool $(shields_list_contains,G80_11900)
```
